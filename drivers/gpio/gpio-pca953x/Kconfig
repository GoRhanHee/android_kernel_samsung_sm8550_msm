## drivers/gpio/gpio-pca953x/Kconfig
```kconfig
#
# PCA953X configurations
#

comment "PCA953X configs"

config GPIO_PCA953X_RESET
	bool "Using GPIO-PCA953X Reset"
	default n
	depends on GPIO_PCA953X && SEC_Q5Q_PROJECT
	help
	  If you say yes here you will get support for
	  reset pin control of PCA953X.
```

## drivers/input/misc/hall/akm/Kconfig
```kconfig
config INPUT_DIGITAL_HALL_AKM
	tristate "Enable AKM DIGITAL HALL IC"
	depends on I2C && (SEC_Q5Q_PROJECT || SEC_B5Q_PROJECT)
	help
	  Say Y to enable support of akm digital hall ic.

	  To compile this driver as a module, choose M here: the
	  module will be called akm.
```

## drivers/sec_panel_notifier/Kconfig
```kconfig
#
# samsung panel notifier
#

config SEC_PANEL_NOTIFIER
	tristate "samsung panel notifier"
	depends on !SEC_Q5Q_PROJECT
	help
	  Samsung panel notifier.
```

## drivers/sensors/Kconfig
```kconfig
# SPDX-License-Identifier: GPL-2.0-only

config SENSORS
	tristate "Sensors Class Support"
	help
	  This option enables the sensor sysfs class in /sys/class/sensors.
	  You'll need this to do anything useful with sensors. If unsure, say N.

config SENSORS_SX9380
	tristate "SX9380 driver"
	default n
	depends on I2C && SEC_B5Q_PROJECT
	help
	  Say Y here if you use sx9380.

config SENSORS_SX9380_SUB
	tristate "SX9380 sub driver"
	default n
	depends on I2C && SEC_B5Q_PROJECT
	help
	  Say Y here if you use sx9380 sub.

config SENSORS_SX9380_SUB2
	tristate "SX9380 sub2 driver"
	default n
	depends on I2C && SEC_B5Q_PROJECT
	help
	  Say Y here if you use sx9380 sub2.

config SENSORS_COMMON_VDD_SUB
	bool "SX9380 common VDD"
	default n
	depends on SEC_B5Q_PROJECT
	help
	  Say Y here if main and sub sx9380 use common VDD.
```

## drivers/sensors_lego/Kconfig
```kconfig
#
# grip sensors configuration
#

config SENSORS_ISG6320
	depends on I2C
	tristate "ISG6320 grip"
	default n
	help
	  If you say yes here if you use ISG6320 for grip.
	  This option enables grip sensors using
	  IMAGIS ISG6320 device driver for grip.

config SENSORS_ISG6320_SUB
	depends on I2C
	tristate "ISG6320 grip sub"
	default n
	help
	  If you say yes here if you use ISG6320_SUB for grip sub.
	  This option enables grip sensors using
	  IMAGIS ISG6320_SUB device driver for grip sub.

config SENSORS_ISG6320_SUB2
	depends on I2C
	tristate "ISG6320 grip sub2"
	default n
	help
	  If you say yes here if you use ISG6320_SUB2 for grip sub2.
	  This option enables grip sensors using
	  IMAGIS ISG6320_SUB2 device driver for grip sub2.

config SENSORS_ISG6320_WIFI
	depends on I2C
	tristate "ISG6320 grip wifi"
	default n
	help
	  If you say yes here if you use ISG6320_WIFI for grip wifi.
	  This option enables grip sensors using
	  IMAGIS ISG6320_WIFI device driver for grip wifi.

config SENSORS_SUPPORT_SLSI
	tristate "Need to set if the driver is working based on Exynos Chip Set"
	default n
	help
	  If you say yes here, the driver is working based on Exynos Chip Set.
	  This option enable the feature that is related with Exynos Chip Set.
	  
config SENSORS_SUPPORT_QCOM
	tristate "Need to set if the driver is working based on Snapdragon Chip Set"
	default n
	help
	  If you say yes here, the driver is working based on Snapdragon Chip Set.
	  This option enable the feature that is related with Snapdragon Chip Set.
	  
config SENSORS_SUPPORT_MTK
	tristate "Need to set if the driver is working based on Mediatek Chip Set"
	default n
	help
	  If you say yes here, the driver is working based on Mediatek Chip Set.
	  This option enable the feature that is related with Mediatek Chip Set.

config SENSORS_CORE_AP
	tristate "Need to use Sensors core ap version"
	default n
	help
	  Say Y here if you using sensors_core.c included under drivers/sensors etc.

config TEST_FOR_GRIP
	tristate "Grip sensor test"
	default n
	help
	  Enable grip test
	  This option enables logs or functions for grip test.

config USE_MULTI_CHANNEL
	tristate "Grip sensor multi chennel"
	default n
	help
	  Enable grip multi channel
	  This option enables feature that is related multi-Channel for grip Sensor.
	  
config UNSUPPORT_UNKNOWN_MODE
	tristate "Unsupport unknown mode for specific regions"
	default n
	help
	  This option disable grip unknown mode concept for specific project.

config SUPPORT_MCC_THRESHOLD_CHANGE
	depends on I2C
	tristate "Change grip sensor threshold according to the MCC value"
	default n
	help
	  Say Y here if you need to check mcc(mobile country code).
	  This option enables when it is necessary to adjust the threshold
	  according to the mcc value.
	  Say N here if you do not need to check mcc.
	  
config SENSORS_SKIP_CABLE_RESET
	tristate "skip grip reset when usb/ta/data cable attached"
	default n
	help
	  new ANFR concept to skip grip reset  

config SENSORS_DUMP_DATA
	tristate "Grip sensor dump log"
	default n
	help
	  Enable grip dump log data
	  This option activates log output of grip error data using sensordump_notifier.

config SENSORS_GRIP_FAILURE_DEBUG
	bool "Grip failure debug"
	help
	  Say Y here, Enable Grip failure debug flag.

config SENSORS_GRIP_SCANOFF
	bool "Grip sensor low power sleep mode"
	default n
	help
	  Scan off for low current consumption of the unused grip sensor.
	  This option is for DM USA&CAN models, user binary.

config SENSORS_A96T396
	tristate "A96T396 driver for grip"
	default n
	depends on I2C && SEC_Q5Q_PROJECT
	help
	  Say Y here if you use A96T396 for grip.

config SENSORS_A96T396_SUB
	tristate "A96T396 sub driver for grip"
	default n
	depends on I2C && SEC_Q5Q_PROJECT
	help
	  Say Y here if you use A96T396 for the sub grip sensor.

config SENSORS_A96T396_SUB2
	tristate "A96T396 second sub driver for grip"
	default n
	depends on I2C && SEC_Q5Q_PROJECT
	help
	  Say Y here if you use a second A96T396 sub grip sensor.

config SENSORS_A96T396_WIFI
	tristate "A96T396 Wi-Fi driver for grip"
	default n
	depends on I2C && SEC_Q5Q_PROJECT
	help
	  Say Y here if you use A96T396 for the Wi-Fi grip sensor.

config SENSORS_A96T396_LDO_SHARE
	tristate "A96T396 shared LDO"
	default n
	depends on I2C && SEC_Q5Q_PROJECT
	help
	  Say Y here if the A96T396 sensors share an LDO.

config SENSORS_A96T396_CRC_CHECK
	bool "Use CRC instead of checksum comparison"
	default n
	depends on SEC_Q5Q_PROJECT
	help
	  Say Y here to validate A96T396 firmware with CRC.

config SENSORS_A96T396_BENZ2
	tristate "Benz2 A96T396 firmware"
	default n
	depends on I2C && SEC_Q5Q_PROJECT
	help
	  Say Y here if you use the Benz2 grip firmware.

config SENSORS_FW_VENDOR
	tristate "Grip sensor firmware in vendor"
	default n
	depends on I2C && SEC_Q5Q_PROJECT
	help
	  Say Y here if grip sensor firmware is stored in vendor.

config SENSORS_A96T396_2CH
	tristate "A96T396 two-channel grip sensor"
	default n
	depends on I2C && SEC_Q5Q_PROJECT
	help
	  Say Y here if the main A96T396 grip sensor uses two channels.

config SENSORS_A96T396_SUB_2CH
	tristate "A96T396 sub two-channel grip sensor"
	default n
	depends on I2C && SEC_Q5Q_PROJECT
	help
	  Say Y here if the sub A96T396 grip sensor uses two channels.

config SENSORS_LOW_TEMP_COMP
	bool "Grip condition for low temperature"
	default n
	depends on SEC_Q5Q_PROJECT
	help
	  Say Y here if you need low-temperature compensation.

config SENSORS_SUPPORT_LOGIC_PARAMETER
	bool "Support grip logic firmware"
	default n
	depends on SEC_Q5Q_PROJECT
	help
	  Say Y here if the model supports logic firmware.
```
